## config/boards/shields/dactyl_cc/Kconfig.defconfig
```kconfig
if SHIELD_DACTYL_CC_LEFT

    config ZMK_KEYBOARD_NAME
        default "Dactyl CC"

    config ZMK_SPLIT_BLE_ROLE_CENTRAL
        default y
endif

if SHIELD_DACTYL_CC_RIGHT

    config ZMK_KEYBOARD_NAME
        default "Dactyl CC Right"

endif

if SHIELD_DACTYL_CC_LEFT || SHIELD_DACTYL_CC_RIGHT

    config ZMK_SPLIT
        default y

endif
```
